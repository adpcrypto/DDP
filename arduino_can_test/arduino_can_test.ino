#include "FlexCAN_T4.h"

/* Loopback test on Teensy 3.6 can0 transmitting to can1 */

FlexCAN_T4<CAN1, RX_SIZE_16, TX_SIZE_256> canPort;
//FlexCAN_T4<CAN1, RX_SIZE_16, TX_SIZE_256> can1;

double fc_val(double speed, double throttle1)
{
  static const double V[3621] = {0.25,
                                 0.260425727145534,
                                 0.274734624647257,
                                 0.28965277312364,
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                                 0.0,
                                 0.0};
  double d;
  double fc;
  double qx1;
  double rx;
  double zx1y1;
  double zx1y2;
  int b_low_i;
  int high_i;
  int low_i;
  int low_ip1;
  int mid_i;
//  if (!isInitialized_fc_val) {
//    fc_val_initialize();
//  }
  
  /*   */
  if ((speed >= 2500.0) && (speed <= 6000.0) && (throttle1 >= 0.0) &&
      (throttle1 <= 100.0)) {
    low_i = 1;
    low_ip1 = 2;
    high_i = 71;
    while (high_i > low_ip1) {
      mid_i = (low_i + high_i) >> 1;
      if (speed >= 50.0 * ((double)mid_i - 1.0) + 2500.0) {
        low_i = mid_i;
        low_ip1 = mid_i + 1;
      } else {
        high_i = mid_i;
      }
    }
    b_low_i = 1;
    low_ip1 = 2;
    high_i = 51;
    while (high_i > low_ip1) {
      mid_i = (b_low_i + high_i) >> 1;
      if (throttle1 >= 2.0 * ((double)mid_i - 1.0)) {
        b_low_i = mid_i;
        low_ip1 = mid_i + 1;
      } else {
        high_i = mid_i;
      }
    }
    low_ip1 = b_low_i + 51 * (low_i - 1);
    zx1y1 = V[low_ip1 - 1];
    high_i = b_low_i + 51 * low_i;
    qx1 = V[high_i - 1];
    zx1y2 = V[low_ip1];
    fc = V[high_i];
    rx = 50.0 * ((double)low_i - 1.0) + 2500.0;
    if (speed == rx) {
      qx1 = zx1y1;
      fc = zx1y2;
    } else {
      d = 50.0 * (double)low_i + 2500.0;
      if (!(speed == d)) {
        rx = (speed - rx) / (d - rx);
        if (zx1y1 == qx1) {
          qx1 = zx1y1;
        } else {
          qx1 = (1.0 - rx) * zx1y1 + rx * qx1;
        }
        if (zx1y2 == fc) {
          fc = zx1y2;
        } else {
          fc = (1.0 - rx) * zx1y2 + rx * fc;
        }
      }
    }
    rx = 2.0 * ((double)b_low_i - 1.0);
    if ((throttle1 == rx) || (qx1 == fc)) {
      fc = qx1;
    } else {
      low_ip1 = 2 * b_low_i;
      if (!(throttle1 == low_ip1)) {
        rx = (throttle1 - rx) / ((double)low_ip1 - rx);
        fc = (1.0 - rx) * qx1 + rx * fc;
      }
    }
  } else {
    fc = 0;
  }
  return fc;
}

CAN_message_t tx_msg, rx_msg;
struct mydata{
  float millivoltdata =0.123456; //millivolt
  float SOC=0.5123456789;
  float current=0;
  int maxCharge = 123;
  int maxDischarge =123;
  float maxTemp =-5;
  float minTemp =5;
  float engineRPM=0;
  float motorRPM=0;
  float engineTorque=0;
  float mototrTorque=0;
  float totalDist=0;
  float kmpl=0;
  float enginethrottle=0;
  float handthrottle=0;
  float fuel=0.0001;
  float dist=0;
  float veh_speed=00;
}data;

int count=0;

void irq(const CAN_message_t &ref) {

  if(ref.id == 16){
    //Serial.println("16");
    uint8_t* msg;
    msg = ref.buf;
    
    uint16_t voltagedata = (msg[0]<<6)|(msg[1]>>2);
    int voltage = (int) voltagedata;
    voltage = voltage*5;
    data.millivoltdata = voltage;
    
   
    
    uint16_t SOCdata = (msg[2]<<2)|(msg[3]>>6);
    int SOC1 = (int) SOCdata;
    data.SOC = (float) SOC1*0.1/100; 

    uint16_t currentData = (msg[4]<<8)|(msg[5]);
    int current = (int) currentData;
    data.current = current/100;
    
  }else if(ref.id==17){
     uint8_t* msg;
     msg = ref.buf;

     data.maxDischarge = msg[0];
     data.maxCharge = msg[7];

     data.maxTemp = ((float)msg[4] -56.0)*0.5;
     data.minTemp = ((float)msg[5] -56.0)*0.5;
     
  }else if(ref.id==256){
    uint8_t* msg;
    msg = ref.buf;
    
    uint16_t enginespeed = (msg[0]<<8)|(msg[1]);
    int speed1 = (int) enginespeed;
    data.engineRPM = speed1*1.0;
    
    uint16_t enginetorque = (msg[2]<<8)|(msg[3]);
    int torque1 = (int) enginetorque;
    data.engineTorque = (float) torque1*0.01; 

    uint16_t throttle = (msg[4]<<8)|(msg[5]);
    int t = (int) throttle;
    data.enginethrottle = t*0.1;
  }else if(ref.id==257){
    uint8_t* msg;
    msg = ref.buf;
    
    uint16_t motspeed = (msg[0]<<8)|(msg[1]);
    int speed1 = (int) motspeed;
    data.motorRPM = (speed1-8192)*1.0;
    data.veh_speed = data.motorRPM*2*PI*0.229*60*60*1.556/(1000*60*10.47);
    
    uint16_t mottorque = (msg[2]<<8)|(msg[3]);
    int torque1 = (int) mottorque;
    data.mototrTorque = (float) (torque1-16000)/1000; 

    uint16_t throttle = (msg[4]<<8)|(msg[5]);
    int t = (int) throttle;
    data.handthrottle = t*0.1;
  }
  else{
    
  }
}

int prevt=0;
void setup() {
  Serial.begin(115200);
  while (!Serial) {}
  //Serial.println("STARTING TEST");
  /* Enable the CAN transceivers */
  pinMode(26, OUTPUT);
  pinMode(27, OUTPUT);
  digitalWriteFast(26, LOW);
  digitalWriteFast(27, LOW);
  /* Start the CAN bus and set the baud */
  canPort.begin();
  canPort.setBaudRate(500000);
//  can1.begin();
//  can1.setBaudRate(1000000);
  canPort.setRFFN(RFFN_32); // 32 filters
  canPort.enableFIFO();  // enable FIFO
  canPort.setMRP(0);  // prioritize FIFO
  canPort.enableFIFOInterrupt();
  canPort.onReceive(FIFO, irq);
    prevt = millis();
}

void loop() {
    int t = millis();
    if(data.engineRPM<2500){
      data.fuel = data.fuel*1.0 + fc_val(2500,data.enginethrottle)*(t-prevt)/(1000.0*60*60*0.74);
    }else if(data.engineRPM>6000){
      data.fuel = data.fuel*1.0 + fc_val(6000,data.enginethrottle)*(t-prevt)/(1000.0*60*60*0.74);
    }else{
      data.fuel = data.fuel*1.0 + fc_val(data.engineRPM,data.enginethrottle)*(t-prevt)/(1000.0*60*60*0.74);
    }
    data.dist = 1.0*data.dist + data.veh_speed*(t-prevt)/(1000.0*60*60);
    data.kmpl = 1.0*data.dist/data.fuel;
    data.totalDist =1.0*data.totalDist + data.veh_speed*(t-prevt)/(1000.0*60*60);
    prevt=t;
    if(count%210==0){
      Serial.print("TRD");
      Serial.print(data.dist,6);
      Serial.print("#");
      Serial.print("TOD");
      Serial.print(data.totalDist,6);
      Serial.print("#");
      Serial.print("MIL");
      Serial.print(data.kmpl,6);
      Serial.print("#");
      Serial.print("$\n");
    }else if(count%20==0){
      Serial.print("MV");
      Serial.print(data.millivoltdata,6);
      Serial.print("#");
      Serial.print("VS");
      Serial.print(data.veh_speed,6);
      Serial.print("#");
      Serial.print("SOC");
      Serial.print(data.SOC,6);
      Serial.print("#");
      Serial.print("IB");
      Serial.print(data.current,6);
      Serial.print("#");
      Serial.print("MC");
      Serial.print(data.maxCharge,6);
      Serial.print("#");
      Serial.print("MD");
      Serial.print(data.maxDischarge,6);
      Serial.print("#");
      Serial.print("MxT");
      Serial.print(data.maxTemp,6);
      Serial.print("#");
      Serial.print("MnT");
      Serial.print(data.minTemp,6);
      Serial.print("#");
      Serial.print("$\n");
    }else if(count%20==10){
      Serial.print("ERPM");
      Serial.print(data.engineRPM,6);
      Serial.print("#");
      Serial.print("MRPM");
      Serial.print(data.motorRPM,6);
      Serial.print("#");
      Serial.print("ETO");
      Serial.print(data.engineTorque,6);
      Serial.print("#");
      Serial.print("MTO");
      Serial.print(data.mototrTorque,6);
      Serial.print("#");
      Serial.print("THR");
      Serial.print(data.enginethrottle,6);
      Serial.print("#");
      Serial.print("HTR");
      Serial.print(data.handthrottle,6);
      Serial.print("#");
      Serial.print("$\n");
    }
    count++;
    if(count==210){
      count=0;
    }
    delay(50);
  

    

 }
